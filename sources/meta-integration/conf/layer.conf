## sources/meta-integration/conf/layer.conf
```bitbake
# SPDX-FileCopyrightText: none
# SPDX-License-Identifier: CC0-1.0

# We have a conf and classes directory, add to BBPATH
BBPATH .= ":${LAYERDIR}"

# We have recipes-* directories, add to BBFILES
BBFILES += " \
    ${LAYERDIR}/recipes-*/*.bb \
    ${LAYERDIR}/recipes-*/*/*.bb \
    ${LAYERDIR}/recipes-*/*.bbappend \
    ${LAYERDIR}/recipes-*/*/*.bbappend \
"

BBFILE_COLLECTIONS += "integration"
BBFILE_PATTERN_integration = "^${LAYERDIR}/"
BBFILE_PRIORITY_integration = "40"

LAYERSERIES_COMPAT_integration = "zeus dunfell"
```
